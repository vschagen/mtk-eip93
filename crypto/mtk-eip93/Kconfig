## crypto/mtk-eip93/Kconfig
```kconfig
# SPDX-License-Identifier: GPL-2.0
config CRYPTO_DEV_EIP93_SKCIPHER
	tristate

config CRYPTO_DEV_EIP93_AES
	tristate

config CRYPTO_DEV_EIP93_DES
	tristate

config CRYPTO_DEV_EIP93_HMAC
	tristate

config CRYPTO_DEV_EIP93
	tristate "Support for EIP93 crypto HW accelerators"
	depends on SOC_MT7621
	help
	  EIP93 have various crypto HW accelerators. Select this if
	  you want to use the EIP93 modules for any of the crypto algorithms.

if CRYPTO_DEV_EIP93

config CRYPTO_DEV_EIP93_SKCIPHER_AES
	bool "Register AES algorithm implementations with the Crypto API"
	default y
	select CRYPTO_DEV_EIP93_SKCIPHER
	select CYRPTO_DEV_EIP93_AES
	select CRYPTO_LIB_AES
	select CRYPTO_SKCIPHER
	help
	  Selecting this will offload AES - ECB, CBC and CTR crypto
	  to the EIP-93 crypto engine.

config CRYPTO_DEV_EIP93_SKCIPHER_DES
	bool "Register legacy DES / 3DES algorithm with the Crypto API"
	default y
	select CRYPTO_DEV_EIP93_SKCIPHER
	select CRYPTO_DEV_EIP93_DES
	select CRYPTO_LIB_DES
	select CRYPTO_SKCIPHER
	help
	  Selecting this will offload DES and 3DES ECB and CBC
	  crypto to the EIP-93 crypto engine.

config CRYPTO_DEV_EIP93_AEAD
  	bool "Register AEAD algorithm with the Crypto API"
  	default y
	select CRYPTO_DEV_EIP93_HMAC
	select CRYPTO_DEV_EIP93_AES
	select CRYPTO_AEAD
	select CRYPTO_AUTHENC
	select CRYPTO_MD5
	select CRYPTO_SHA1
	select CRYPTO_SHA256
	help
  	  Selecting this will offload AEAD authenc(hmac(x), cipher(y))
	  crypto to the EIP-93 crypto engine. When legacy DES is selected,
		these will also be used for AEAD.

config CRYPTO_DEV_EIP93_HASH
	bool "Register HASH algorithm implementatons with the Crypto API"
	default n
	select CRYPTO_MD5
	select CRYPTO_SHA1
	select CRYPTO_SHA256
	help
	  Selecting this will offload SHA1, SHA224 and SHA256 hash algorithm
	  and HMAC(SHA1), HMAC(SHA224) and HMAC(SHA256) to the EIP-93 crypto
	  engine.

config CRYPTO_DEV_EIP93_PRNG
	bool "Register PRNG device with the Crypto API"
	default n
	help
	  Selecting this will add the ANSI X9.31 Pseudo Random Number Generator
	  to the EIP-93 crypto engine.

config CRYPTO_DEV_EIP93_IPSEC
	bool "Register IPSec ESP hardware offloading"
	default n
	select CRYPTO_DEV_EIP93_PRNG
	select CRYPTO_DEV_EIP93_HMAC
	help
	  Selecting this will add ESP HW offloading for IPSec
	  to the EIP-93 crypto engine. Requires IPSec offload
	  to be selected with the Mediatek Ethernet Driver
endif
```

## mtk-eip93/Kconfig
```kconfig
# SPDX-License-Identifier: GPL-2.0
config MTK_EIP93
	tristate "MTK EIP93 support"
	depends on RALINK && SOC_MT7621
```
